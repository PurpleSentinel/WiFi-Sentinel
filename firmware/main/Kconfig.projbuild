## firmware/main/Kconfig.projbuild
```kconfig
menu "WiFi Sentinel sensor configuration"
    config WIDS_SENSOR_ID
        string "Sensor ID (letters, numbers, dots, dashes, underscore)"
        default "c5-sensor-01"
        help
            Non-secret, stable identifier. Maximum 40 characters.

    choice WIDS_BAND
        prompt "Receive band (not simultaneous dual-band)"
        default WIDS_BAND_2G
        config WIDS_BAND_2G
            bool "2.4 GHz"
        config WIDS_BAND_5G
            bool "5 GHz"
            depends on SOC_WIFI_SUPPORT_5G
    endchoice

    config WIDS_CHANNEL
        int "Fixed receive channel (legal for your regulatory region)"
        default 6
        range 1 14 if !SOC_WIFI_SUPPORT_5G
        range 1 177 if SOC_WIFI_SUPPORT_5G
        help
            2.4 GHz typical: 1, 6, 11. 5 GHz example: 36.
            Check the correct band and local regulatory permissions.

    config WIDS_BEACON_SAMPLE_N
        int "Report one in N advertisements per BSSID/channel/subtype"
        default 20
        range 1 1000
        help
            Beacon/probe sampling saves transport and storage bandwidth;
            the first observation of each BSSID/channel/subtype is reported,
            then every Nth observation. A fixed 64-entry table bounds memory;
            evicted identities report their next first sighting again. Counts
            remain non-exhaustive. Flood frame types are not sampled.

    config WIDS_HEARTBEAT_SECONDS
        int "Heartbeat period in seconds"
        default 15
        range 1 300
endmenu
```

## firmware/sdkconfig.defaults.esp32c6
```kconfig
CONFIG_ESP_CONSOLE_USB_SERIAL_JTAG=y
CONFIG_WIDS_SENSOR_ID="c6-sensor-01"
CONFIG_WIDS_CHANNEL=6
```
